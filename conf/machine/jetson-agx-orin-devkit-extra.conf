## conf/machine/jetson-agx-orin-devkit-extra.conf
```bitbake
#@TYPE: Machine
#@NAME: Nvidia Jetson Orin
#@DESCRIPTION: Nvidia Jetson Orin dev board
#
#
PARTITION_LAYOUT_TEMPLATE = "flash_t234_qspi_sdmmc_custom.xml"
```
